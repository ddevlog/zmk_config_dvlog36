## config/west.yml
```yaml
manifest:
  remotes:
    - name: zmkfirmware
      url-base: https://github.com/zmkfirmware
    - name: haerttrich
      url-base: https://github.com/haerttrich
  projects:
    - name: zmk
      remote: zmkfirmware
      revision: main # или конкретный тег, например v3.5.0
      import: app/west.yml
    - name: zmk-nice-custom
      remote: haerttrich
      revision: main
  self:
    path: config
```
